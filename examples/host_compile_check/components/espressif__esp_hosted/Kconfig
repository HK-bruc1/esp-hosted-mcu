## examples/host_compile_check/sdkconfig.defaults
```kconfig
CONFIG_ESP_HOSTED_ENABLED=y
CONFIG_ESP_HOSTED_TRANSPORT_RESTART_ON_FAILURE=n

CONFIG_ESP_WIFI_ENABLED=y
CONFIG_FREERTOS_HZ=1000

CONFIG_LOG_DEFAULT_LEVEL_INFO=y
```
